/dts-v1/;
/plugin/;

/ {
    fragment@0 {
        target-path = "/fpga-full";
        __overlay__ {
            firmware-name = "level1_gpio_wrapper.bit.bin";
        };
    };

    fragment@1 {
        target-path = "/amba";
        __overlay__ {
            #address-cells = <2>;
            #size-cells = <2>;

            gpio_0: gpio@a0100000 {
                compatible = "generic-uio";
                reg = <0x0 0xa0100000 0x0 0x10000>;
            };
        };
    };
};
