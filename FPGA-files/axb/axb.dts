/dts-v1/;
/plugin/;

/ {
    fragment@0 {
        target-path = "/fpga-full";
        __overlay__ {
            firmware-name = "axb_wrapper.bit.bin";
        };
    };

    fragment@1 {
        target-path = "/amba";
        __overlay__ {
            #address-cells = <2>;
            #size-cells = <2>;

            axb_0: axb@a0200000 {
                compatible = "generic-uio";
                reg = <0x0 0xa0200000 0x0 0x10000>;
            };
        };
    };
};
