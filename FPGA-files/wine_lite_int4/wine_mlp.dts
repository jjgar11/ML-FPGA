/dts-v1/;
/plugin/;

/ {
    fragment@0 {
        target-path = "/fpga-full";
        __overlay__ {
            firmware-name = "wine_int4_wrapper.bit.bin";
        };
    };

    fragment@1 {
        target-path = "/amba";
        __overlay__ {
            wine_mlp_0: wine_mlp@a0200000 {
                compatible = "generic-uio";
                reg = <0x0 0xa0200000 0x0 0x10000>;
            };
        };
    };
};
