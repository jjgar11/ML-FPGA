/dts-v1/;
/plugin/;

/ {
    fragment@0 {
        target-path = "/amba_pl@0/axi_bram_ctrl@a0000000";
        __overlay__ {
            status = "disabled";
        };
    };

    fragment@1 {
        target-path = "/fpga-full";
        __overlay__ {
            firmware-name = "design_1_wrapper.bit.bin";
        };
    };

    fragment@2 {
        target-path = "/amba_pl@0";
        __overlay__ {
            wine_dma_0: wine_axi_dma@a0000000 {
                compatible = "generic-uio";
                reg = <0x0 0xa0000000 0x0 0x10000>;
            };
        };
    };
};
